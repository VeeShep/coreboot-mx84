## meraki/buildroot/mx84.its
```
/dts-v1/;

/ {
	description = "Free Linux rescue environment for Cisco Meraki MX84";
	#address-cells = <1>;
	meraki-build = "mx84-buildroot-2026.05.1-milesfix1";

	images {
		kernel-1 {
			description = "Linux 6.18.7 kernel";
			data = /incbin/("bzImage");
			type = "kernel";
			arch = "x86";
			os = "linux";
			compression = "none";
			load = <0x00008000>;
			entry = <0x00008000>;
			hash-1 {
				algo = "sha1";
			};
		};

		ramdisk-1 {
			description = "Buildroot initramfs";
			data = /incbin/("rootfs.cpio.gz");
			type = "ramdisk";
			arch = "x86";
			os = "linux";
			compression = "gzip";
			hash-1 {
				algo = "sha1";
			};
		};
	};

	configurations {
		default = "config-1";
		config-1 {
			description = "MX84 serial rescue console (Miles init_size fallback)";
			kernel = "kernel-1";
			ramdisk = "ramdisk-1";
			command-line = "console=ttyS1,115200n8 earlyprintk=serial,ttyS1,115200 earlycon=uart8250,io,0x2f8,115200n8 loglevel=8 rdinit=/sbin/init gpio-ich.initial_dir=0xFDFFFFEF,0xF785FFF3 gpio-ich.initial_vals=0x02000010,0x0078000C MERAKI_BOARD=pocahontas";
		};
	};
};
```

## meraki/buildroot/mx84_defconfig
```kconfig
BR2_x86_64=y
BR2_PACKAGE_HOST_LINUX_HEADERS_CUSTOM_6_18=y
BR2_TOOLCHAIN_BUILDROOT_MUSL=y
BR2_TARGET_GENERIC_HOSTNAME="mx84"
BR2_TARGET_GENERIC_ISSUE="MX84 free rescue Linux"
BR2_TARGET_GENERIC_GETTY_PORT="ttyS1"
BR2_TARGET_GENERIC_GETTY_BAUDRATE_115200=y
BR2_GLOBAL_PATCH_DIR="board/mx84/patches"
BR2_ROOTFS_OVERLAY="board/mx84/rootfs-overlay"
BR2_LINUX_KERNEL=y
BR2_LINUX_KERNEL_CUSTOM_VERSION=y
BR2_LINUX_KERNEL_CUSTOM_VERSION_VALUE="6.18.7"
BR2_LINUX_KERNEL_USE_CUSTOM_CONFIG=y
BR2_LINUX_KERNEL_CUSTOM_CONFIG_FILE="board/mx84/linux.config"
BR2_LINUX_KERNEL_NEEDS_HOST_LIBELF=y
BR2_LINUX_KERNEL_XZ=y
BR2_PACKAGE_BUSYBOX_SHOW_OTHERS=y
BR2_PACKAGE_ETHTOOL=y
BR2_PACKAGE_FLASHROM=y
BR2_PACKAGE_I2C_TOOLS=y
BR2_PACKAGE_IPROUTE2=y
BR2_PACKAGE_LIBGPIOD=y
BR2_PACKAGE_LIBGPIOD_TOOLS=y
BR2_PACKAGE_MDIO_TOOLS=y
BR2_PACKAGE_PCIUTILS=y
BR2_TARGET_ROOTFS_CPIO=y
BR2_TARGET_ROOTFS_CPIO_GZIP=y
# BR2_TARGET_ROOTFS_TAR is not set
BR2_PACKAGE_HOST_UBOOT_TOOLS=y
BR2_PACKAGE_HOST_UBOOT_TOOLS_FIT_SUPPORT=y
```
